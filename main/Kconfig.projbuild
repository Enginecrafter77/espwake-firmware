## main/Kconfig.projbuild
```kconfig
menu "espwake"
    config ESPWAKE_DEFAULT_CONTROL_PASSWORD
        string "Default protocol password"
        default "espwake"
        help
            The password used to authorize control actions

    config ESPWAKE_DEFAULT_HOSTNAME
        string "Hostname"
        default "espwake"
        help
            The DHCP advertised hostname of the espwake instance
    
    config ESPWAKE_HOSTNAME_APPEND_MAC
        bool "Append MAC to hostname"
        default "true"
        help
            If enabled, the last 3 bytes of the programmed MAC address are appended to the hostname.
            This option represents a best effort approach to make sure that each device gets its own unique hostname.
    
    menu "Debug"
        config ESPWAKE_DEBUG_SIMULATED_POWER_EVENTS
            bool "Simulated power events"
            default "false"
            help
                Enabling this option adds a timer which simulates the power state changes as if they were caused by HW.
                Useful for debugging without the espwake hardware connected
        
        config ESPWAKE_DEBUG_NODEMCU_LED
            bool "NodeMCU debug led"
            default "false"
            help
                When the power switch is held, light up the NodeMCU blue LED (GPIO16). Useful for debugging.
    endmenu
    
    menu "Sequence timing"
        config ESPWAKE_SEQ_START_HOLD_MS
            int "Start hold time (ms)"
            default "300"
            help
                The time the power button is held when starting the PC
        
        config ESPWAKE_SEQ_SHUTDOWN_HOLD_MS
            int "Shutdown hold time (ms)"
            default "300"
            help
                The time the power button is held when sending shutdown to the PC
        
        config ESPWAKE_SEQ_FORCEOFF_HOLD_MS
            int "Force off hold time (ms)"
            default "5000"
            help
                The time the power button is held when forcing power off of the PC
    endmenu
endmenu
```
